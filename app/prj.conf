## CMakeLists.txt
```
# ********************************************************************************
# 
# CMake file used to build the project.
# 
# Created on Wed Nov 20 2024
# 
# Daniel Figueira <daniel.castro.figueira@gmail.com>
# 
# ********************************************************************************

cmake_minimum_required(VERSION 3.20.0)
find_package(Zephyr REQUIRED HINTS $ENV{ZEPHYR_BASE})
project(app)

# Compiler options
target_compile_options(app PRIVATE -Wall -Werror)

# Header files
zephyr_library_include_directories(include)

# Source files
file(GLOB_RECURSE APP_SRC "src/*.c")
target_sources(app PRIVATE ${APP_SRC} main.c)
```

## prj.conf
```kconfig
# Configure Logs 
CONFIG_LOG=y
CONFIG_LOG_BUFFER_SIZE=4096
CONFIG_USB_DRIVER_LOG_LEVEL_ERR=y
CONFIG_USB_CDC_ACM_LOG_LEVEL_ERR=y

# Add support for floats
CONFIG_NEWLIB_LIBC=y
CONFIG_NEWLIB_LIBC_FLOAT_PRINTF=y
CONFIG_FPU=y

# Add support for USB communications
CONFIG_USB_DEVICE_STACK=y
CONFIG_USB_DEVICE_PID=0x4321
CONFIG_USB_DEVICE_VID=0x1234
CONFIG_UART_LINE_CTRL=y
CONFIG_UART_INTERRUPT_DRIVEN=y

# Add support for random number generation
CONFIG_ENTROPY_GENERATOR=y
```

## boards/nrf5340dk_nrf5340_cpuapp.overlay
```dts
/* Setup USB communication over UART */
&zephyr_udc0 {
    cdc_acm_uart0 {
        compatible = "zephyr,cdc-acm-uart";
    };
};
```

## include/command_parser.h
```c
/**
 * Created on Sat Nov 23 2024
 *
 * @brief Provides methods to parse and execute commands received over USB.
 *
 * @author Daniel Figueira <daniel.castro.figueira@gmail.com>
 */
#pragma once

#include <stdbool.h>
#include <stddef.h>
#include <stdint.h>

#define MAX_COMMAND_ARGS 4

/* Type definitions */
typedef enum {
    COMMAND_SET_DATA_RATE = 0,
    COMMAND_SET_READ_RATE = 1,
    COMMAND_SET_SEND_RATE = 2,
    COMMAND_START_PATTERN = 3,
    COMMAND_MAX_VALUE,
} command_type_t;

typedef struct {
    command_type_t type;
    float args[MAX_COMMAND_ARGS];
} command_t;

/**
 * @brief Parse a command received over USB.
 *
 * @param data A null-terminated string to be parsed.
 * @param command The command parsed (output).
 * @return 0 on success, negative errno on failure.
 */
int command_parse(char* data, command_t* command);

/**
 * @brief Execute a command.
 *
 * @param command The command to be executed.
 * @return 0 on success, negative errno on failure.
 */
int command_execute(command_t* command);
```

## include/data_thread.h
```c
/**
 * Created on Mon Nov 25 2024
 *
 * @brief Provides methods to interact with the data thread, whose
 *        responsibility is to send data over USB at a fixed rate.
 *
 * @author Daniel Figueira <daniel.castro.figueira@gmail.com>
 */
#pragma once

#include "ring_buffer.h"

#include <stdbool.h>
#include <stddef.h>
#include <stdint.h>

/**
 * @brief Set the data rate at which sensor data will be sent over USB.
 *
 * @param read_rate The send rate in Hz (max: 1000Hz).
 */
void data_thread_set_send_rate(uint16_t send_rate);

/**
 * @brief Start the data thread.
 *
 * @param ring_buffer The ring buffer used to store the sensor data.
 */
void data_thread_start(ring_buffer_t* ring_buffer);
```

## include/led.h
```c
/**
 * Created on Thu Nov 21 2024
 *
 * @brief Provides methods to interact with the board leds.
 *
 * @author Daniel Figueira <daniel.castro.figueira@gmail.com>
 */
#pragma once

#include <stdbool.h>
#include <stddef.h>
#include <stdint.h>

/**
 * @brief Initializes the board leds.
 *
 * @return 0 on success, negative errno code on fail.
 */
int led_init(void);

/**
 * @brief Toggles the state of the board first led (led0).
 *
 * @return 0 on success, negative errno on failure.
 */
int led_toggle(void);

/**
 * @brief Turns on the board first led (led0).
 *
 * @return 0 on success, negative errno on failure.
 */
int led_on(void);

/**
 * @brief Turns off the board first led (led0).
 *
 * @return 0 on success, negative errno on failure.
 */
int led_off(void);
```

## include/ring_buffer.h
```c
/**
 * Created on Mon Nov 25 2024
 *
 * @brief Simple ring buffer implementation, which keeps a static number of items in a FIFO order.
 *        Once full, the oldest items are discarded.
 *
 * @note Zephyr RTOS provides it's own ring buffer implementation (zephyr/sys/ring_buffer.h),
 *       so I'm only adding this one for demonstration purposes.
 *
 * @author Daniel Figueira <daniel.castro.figueira@gmail.com>
 */
#pragma once

#include <stdbool.h>
#include <stddef.h>
#include <stdint.h>

/* Constants */
#define RING_BUFFER_MAX_ITEMS 10              // max: 65535
#define RING_BUFFER_ITEM_SIZE sizeof(float)   // max: 255 bytes

/* Type definitions */
typedef struct {
    uint8_t items[RING_BUFFER_MAX_ITEMS][RING_BUFFER_ITEM_SIZE];
    uint8_t sizes[RING_BUFFER_MAX_ITEMS];
    uint16_t start_idx;
    uint16_t end_idx;
    uint16_t n_items;
} ring_buffer_t;

/**
 * @brief Add a new item to the ring buffer. This will copy the item to the buffer,
 *        overwriting the oldest item if the buffer is full.
 *
 * @param buffer The ring buffer to add the item to.
 * @param item The item to add.
 * @param item_size The size of the item do add.
 * @return 0 on success, negative errno on failure.
 */
int ring_buffer_add(ring_buffer_t* buffer, void* item, uint8_t item_size);

/**
 * @brief Retrieve the oldest item from the ring buffer (and remove it).
 *
 * @param buffer The ring buffer to get the item from.
 * @param item The item retrieved (output).
 * @param item_size The size of the item retrieved (output).
 * @return 0 on success, negative errno on failure.
 */
int ring_buffer_get(ring_buffer_t* buffer, void* item, uint8_t* item_size);
```

## include/sensor_thread.h
```c
/**
 * Created on Sat Nov 23 2024
 *
 * @brief Provides methods to interact with the sensor thread, whose
 *        responsibility is to read sensor data at fixed data rate.
 *
 * @author Daniel Figueira <daniel.castro.figueira@gmail.com>
 */
#pragma once

#include "ring_buffer.h"

#include <stdbool.h>
#include <stddef.h>
#include <stdint.h>

/**
 * @brief Set the data rate at which sensor data will be read
 *
 * @param read_rate The read rate in Hz (max: 1000Hz).
 */
void sensor_thread_set_read_rate(uint16_t read_rate);

/**
 * @brief Start the sensor thread.
 *
 * @param ring_buffer The ring buffer used to store the sensor data.
 */
void sensor_thread_start(ring_buffer_t* ring_buffer);
```

## include/sim_sensor.h
```c
/**
 * Created on Thu Nov 21 2024
 *
 * @brief Provides methods to simulate sensor data.
 *
 * @author Daniel Figueira <daniel.castro.figueira@gmail.com>
 */
#pragma once

#include <stdbool.h>
#include <stddef.h>
#include <stdint.h>

typedef enum {
    // The sensor will repeatedly return a the same value until
    // a certain number of samples is reached.
    // arg1: constant value
    // arg2: number of samples
    PATTERN_CONST = 0,

    // The sensor will repeatedly return a value that is increased
    // by a constant amount until a maximum value is reached.
    // arg1: initial value
    // arg2: increment amount
    // arg3: maximum value (inclusive)
    PATTERN_INCREASING = 1,

    // The sensor will repeatedly return a value that is decreased
    // by a constant amount until a minimum value is reached.
    // arg1: initial value
    // arg2: decrement amount
    // arg3: minimum value (inclusive)
    PATTERN_DECREASING = 2,

    // The sensor will repeatedly return a random value within a
    // given range until a certain number of samples is reached.
    // arg1: minimum value
    // arg2: maximum value (inclusive)
    // arg3: number of samples
    PATTERN_RANDOM = 3,
} sim_sensor_pattern_t;

/**
 * @brief Set the data rate at which simulated data will be produced.
 *
 * @param data_rate The data rate in Hz (max: 1000Hz).
 */
void sim_sensor_set_data_rate(uint16_t data_rate);

/**
 * @brief Get the current period between simulated data samples.
 *
 * @return The sample period in milliseconds.
 */
uint16_t sim_sensor_get_sample_period(void);

/**
 * @brief Start the simulation of a given data pattern. Once the pattern
 *        is started, data will be produced at the data rate set until a
 *        certain stop condition (pattern-specific) is reached, at which
 *        point no more data will be produced.
 *
 * @param pattern The pattern to be simulated.
 * @param arg1 The first argument for the pattern.
 * @param arg2 The second argument for the pattern.
 * @param arg3 The third argument for the pattern.
 *
 * @note There are several ways I could have passed the arguments of the
 *       pattern here (e.g. a union struct, void pointers, etc). I chose
 *       to use individual floats as arguments because it seemed like to
 *       be the simplest way to send the arguments over USB and directly
 *       pass them into this function.
 */
void sim_sensor_start_pattern(sim_sensor_pattern_t pattern, float arg1, float arg2, float arg3);

/**
 * @brief Check if a new simulated sensor sample is ready to be read.
 *
 * @return True if a new sample is ready, false otherwise.
 */
bool sim_sensor_new_sample_ready(void);

/**
 * @brief Retrieve a simulated sensor sample. Returns NaN if no simulation
 *        is currently ongoing. It will be up to the user to make sure this
 *        function is called exactly once per sample period. Calling this
 *        function more than once per sample period will result in duplicated
 *        data (just like a real sensor would).
 *
 * @return The simulated sensor sample (or NaN).
 */
float sim_sensor_read_sample(void);
```

## include/usb_comm.h
```c
/**
 * Created on Thu Nov 21 2024
 *
 * @brief Provides methods to send and receive data over USB.
 *
 * @author Daniel Figueira <daniel.castro.figueira@gmail.com>
 */
#pragma once

#include <stdbool.h>
#include <stddef.h>
#include <stdint.h>

/**
 * @brief Initializes the USB communication.
 *
 * @return 0 on success, negative errno code on fail.
 *
 * @note This function will block until a USB connection is established.
 */
int usb_comm_init(void);

/**
 * @brief Read data received over USB. This will read as many bytes as there
 *        are available, up to the size of the buffer. If no data is available,
 *        this function returns immediately.
 *
 * @param buffer Buffer to store the data read (output).
 * @param size The size of the buffer (or the max number of bytes you want to read).
 * @param n_bytes The number of bytes read (output).
 * @return 0 on success, negative errno on failure.
 */
int usb_comm_read(uint8_t* buffer, size_t buffer_len, size_t* n_bytes);

/**
 * @brief Write data over USB.
 *
 * @param buffer Buffer containing the data to be written.
 * @param n_bytes The number of bytes to be sent.
 * @return 0 on success, negative errno on failure.
 */
int usb_comm_write(uint8_t* buffer, size_t n_bytes);
```

## src/command_parser.c
```c
/**
 * Created on Sat Nov 23 2024
 *
 * @brief Provides methods to parse and execute commands received over USB.
 *
 * @author Daniel Figueira <daniel.castro.figueira@gmail.com>
 */
#include "command_parser.h"

#include "data_thread.h"
#include "sensor_thread.h"
#include "sim_sensor.h"

#include <zephyr/kernel.h>
#include <zephyr/logging/log.h>

#include <errno.h>
#include <stdio.h>
#include <stdlib.h>

LOG_MODULE_REGISTER(command_parser, LOG_LEVEL_INF);

int command_parse(char* data, command_t* command) {
    LOG_DBG("Parsing command: %s", data);

    memset(command, 0, sizeof(command_t));

    // Parse the command type
    int ret = sscanf(data, "%d", (int*) &command->type);
    if (ret < 1) {
        LOG_ERR("Failed to parse the command.");
        return -EIO;
    }

    // Check if the command type is valid
    if (command->type < 0 || command->type >= COMMAND_MAX_VALUE) {
        LOG_ERR("Invalid command type: %d", command->type);
        return -EIO;
    }

    // Parse the command arguments
    data = strchr(data, ' ');
    for (int i = 0; data != NULL && i < MAX_COMMAND_ARGS; i++) {
        command->args[i] = strtof(data, &data);
    }

    LOG_DBG("Parsed command: type=%d, args=[%.1f, %.1f, %.1f, %.1f]", command->type, command->args[0], command->args[1], command->args[2],
        command->args[3]);

    return 0;
}

int command_execute(command_t* command) {
    switch (command->type) {
        case COMMAND_SET_DATA_RATE: sim_sensor_set_data_rate(command->args[0]); break;
        case COMMAND_SET_READ_RATE: sensor_thread_set_read_rate(command->args[0]); break;
        case COMMAND_SET_SEND_RATE: data_thread_set_send_rate(command->args[0]); break;
        case COMMAND_START_PATTERN:
            sim_sensor_start_pattern((sim_sensor_pattern_t) command->args[0], command->args[1], command->args[2], command->args[3]);
            break;
        default: LOG_ERR("Invalid command type: %d", command->type); return -EINVAL;
    }
    return 0;
}
```

## src/data_thread.c
```c
/**
 * Created on Mon Nov 25 2024
 *
 * @brief Provides methods to interact with the data thread, whose
 *        responsibility is to send data over USB at a fixed rate.
 *
 * @author Daniel Figueira <daniel.castro.figueira@gmail.com>
 */
#include "data_thread.h"

#include "usb_comm.h"

#include <zephyr/kernel.h>
#include <zephyr/logging/log.h>

#include <errno.h>
#include <stdio.h>

LOG_MODULE_REGISTER(data_thread, LOG_LEVEL_INF);

/* Constants */
#define DATA_THREAD_STACK_SIZE 1000
#define DATA_THREAD_PRIO       5
#define DEFAULT_SEND_RATE      1   // Hz

/* Static variables */
K_THREAD_STACK_DEFINE(data_thread_stack, DATA_THREAD_STACK_SIZE);
static struct k_thread data_thread = {0};

static uint16_t send_period      = 1000 / DEFAULT_SEND_RATE;                 // ms
static uint32_t send_wait_us     = (1000 / DEFAULT_SEND_RATE) * 1000 / 10;   // us
static uint64_t next_sample_time = 0;

void data_thread_set_send_rate(uint16_t send_rate) {
    send_period      = (send_rate < 1000) ? 1000 / send_rate : 1;
    send_wait_us     = send_period * 1000 / 10;   // 1/10th of the period
    next_sample_time = k_uptime_get() + send_period;
    LOG_INF("Send rate set to %d Hz (new send period: %d ms)", send_rate, send_period);
}

static void data_thread_wait_fixed_rate(void) {
    while (k_uptime_get() < next_sample_time) {
        k_usleep(send_wait_us);
    }
    next_sample_time += send_period;
}

static void data_thread_loop(ring_buffer_t* ring_buffer) {
    uint8_t buffer[20] = {0};
    uint8_t n_bytes    = 0;
    float sample       = 0.0;

    next_sample_time = k_uptime_get() + send_period;

    while (true) {
        // Wait for the next sample
        data_thread_wait_fixed_rate();

        // Get the next sample from the ring buffer
        int ret = ring_buffer_get(ring_buffer, &sample, &n_bytes);
        if (ret != 0) {
            LOG_ERR("Failed to get sample from the ring buffer (err: %d - %s)", ret, strerror(-ret));
            continue;
        }

        // Check if a sample was retrieved
        if (n_bytes != sizeof(sample)) {
            continue;
        }

        // Convert the sample to text
        n_bytes = snprintf((char*) buffer, sizeof(buffer), "%.1f\n", sample);

        // Send the sample over USB
        ret = usb_comm_write(buffer, n_bytes);
        if (ret != 0) {
            LOG_ERR("Failed to send data over USB");
            continue;
        }

        LOG_DBG("Sent: %.1f", sample);
    }
}

void data_thread_start(ring_buffer_t* ring_buffer) {
    k_thread_create(&data_thread, data_thread_stack, DATA_THREAD_STACK_SIZE, (k_thread_entry_t) data_thread_loop, ring_buffer, NULL, NULL,
        DATA_THREAD_PRIO, 0, K_NO_WAIT);
}
```

## src/led.c
```c
/**
 * Created on Thu Nov 21 2024
 *
 * @brief Provides methods to interact with the board leds.
 *
 * @author Daniel Figueira <daniel.castro.figueira@gmail.com>
 */
#include "led.h"

#include <zephyr/drivers/gpio.h>

static const struct gpio_dt_spec led = GPIO_DT_SPEC_GET(DT_ALIAS(led0), gpios);

int led_init(void) {
    // Check if the led GPIO pin is ready
    if (!gpio_is_ready_dt(&led)) {
        return -1;
    }

    // Configure the led GPIO pin as an output
    int ret = gpio_pin_configure_dt(&led, GPIO_OUTPUT_INACTIVE);
    if (ret != 0) {
        return ret;
    }

    return 0;
}

int led_toggle(void) { return gpio_pin_toggle_dt(&led); }
int led_on(void) { return gpio_pin_set_dt(&led, true); }
int led_off(void) { return gpio_pin_set_dt(&led, false); }
```

## src/ring_buffer.c
```c
/**
 * Created on Mon Nov 25 2024
 *
 * @brief Simple ring buffer implementation, which keeps a static number of items in a FIFO order.
 *        Once full, the oldest items are discarded.
 *
 * @note Zephyr RTOS provides it's own ring buffer implementation (zephyr/sys/ring_buffer.h),
 *       so I'm only adding this one for demonstration purposes.
 *
 * @author Daniel Figueira <daniel.castro.figueira@gmail.com>
 */
#include "ring_buffer.h"

#include <zephyr/logging/log.h>

#include <errno.h>

LOG_MODULE_REGISTER(ring_buffer, LOG_LEVEL_INF);

/*
 * Note that no synchronization mechanisms are needed to manage access to the
 * ring buffer, even though we'll have multiple threads reading/writing to it.
 *
 * This is because while our application has multiple threads, these will be
 * run on a single core and therefore only one thread will be actually run
 * at any given time (see multi-threading vs parallelism).
 *
 * As such, it will be fine as long as we don't give-up the CPU to another thread
 * (by calling some OS function like 'k_sleep' or 'k_yield') mid-way through
 * accessing or modifying items from the ring buffer.
 */

int ring_buffer_add(ring_buffer_t* buffer, void* item, uint8_t item_size) {
    if (buffer == NULL || item == NULL) {
        return -EINVAL;
    }

    // Check if the item size is valid
    if (item_size > RING_BUFFER_ITEM_SIZE) {
        return -ENOMEM;
    }

    // If the buffer is full
    if (buffer->n_items >= RING_BUFFER_MAX_ITEMS) {
        // Advance the start index (overwriting the oldest item)
        LOG_WRN("Ring buffer is full. Item %d discarded.", buffer->start_idx);
        buffer->start_idx = (buffer->start_idx + 1) % RING_BUFFER_MAX_ITEMS;
    } else {
        // Otherwise increase the number of items
        buffer->n_items++;
    }

    // Then copy the item to the buffer
    memcpy(buffer->items[buffer->end_idx], item, item_size);
    buffer->sizes[buffer->end_idx] = item_size;

    // And update the end index
    buffer->end_idx = (buffer->end_idx + 1) % RING_BUFFER_MAX_ITEMS;

    return 0;
}

int ring_buffer_get(ring_buffer_t* buffer, void* item, uint8_t* item_size) {
    if (buffer == NULL || item == NULL || item_size == NULL) {
        return -EINVAL;
    }

    memset(item, 0, RING_BUFFER_ITEM_SIZE);
    *item_size = 0;

    // Check if the buffer is empty
    if (buffer->n_items == 0) {
        return 0;
    }

    // Copy the oldest item
    memcpy(item, buffer->items[buffer->start_idx], buffer->sizes[buffer->start_idx]);
    *item_size = buffer->sizes[buffer->start_idx];

    // Update the start index
    buffer->start_idx = (buffer->start_idx + 1) % RING_BUFFER_MAX_ITEMS;

    // Update the number of items
    buffer->n_items--;

    return 0;
}
```

## src/sensor_thread.c
```c
/**
 * Created on Sat Nov 23 2024
 *
 * @brief Provides methods to interact with the sensor thread.
 *
 * @author Daniel Figueira <daniel.castro.figueira@gmail.com>
 */
#include "sensor_thread.h"

#include "sim_sensor.h"

#include <zephyr/kernel.h>
#include <zephyr/logging/log.h>

#include <errno.h>
#include <math.h>

LOG_MODULE_REGISTER(sensor_thread, LOG_LEVEL_INF);

/* Constants */
#define SENSOR_THREAD_STACK_SIZE 1000
#define SENSOR_THREAD_PRIO       5
#define DEFAULT_READ_RATE        1   // Hz

/* Static variables */
K_THREAD_STACK_DEFINE(sensor_thread_stack, SENSOR_THREAD_STACK_SIZE);
static struct k_thread sensor_thread = {0};

static uint16_t read_period      = 1000 / DEFAULT_READ_RATE;                 // ms
static uint32_t read_wait_us     = (1000 / DEFAULT_READ_RATE) * 1000 / 10;   // us
static uint64_t next_sample_time = 0;

void sensor_thread_set_read_rate(uint16_t read_rate) {
    read_period      = (read_rate < 1000) ? 1000 / read_rate : 1;
    read_wait_us     = read_period * 1000 / 10;   // 1/10th of the period
    next_sample_time = k_uptime_get() + read_period;
    LOG_INF("Read rate set to %d Hz (new read period: %d ms)", read_rate, read_period);
}

// Actively check if a new sample is available - this is what is
// usually done (either through interrupts or by reading the sensor
// status) if we're trying to keep up with the sensor data rate.
static void sensor_thread_wait_for_new_data(void) {
    while (!sim_sensor_new_sample_ready()) {
        k_usleep(read_wait_us);
    }
}

// Alternatively, we can try to force a fixed data rate - just to
// demonstrate that reading the sensor at a different read rate than
// what data is produced will lead to duplicates or missed samples)
// (just like a normal sensor would)
static void sensor_thread_wait_fixed_rate(void) {
    while (k_uptime_get() < next_sample_time) {
        k_usleep(read_wait_us);
    }
    next_sample_time += read_period;
}

static bool sensor_thread_force_fixed_rate(void) {
    static bool force_fixed_rate = true;
    bool new_state               = (read_period != sim_sensor_get_sample_period());

    // When changing to fixed rate adjust the next sample time
    if (new_state != force_fixed_rate && new_state == true) {
        next_sample_time = k_uptime_get() + read_period;
    }

    // Update the current state
    force_fixed_rate = new_state;

    return force_fixed_rate;
}

static void sensor_thread_loop(ring_buffer_t* ring_buffer) {
    while (true) {
        // Wait for the next sample
        if (sensor_thread_force_fixed_rate()) {
            sensor_thread_wait_fixed_rate();
        } else {
            sensor_thread_wait_for_new_data();
        }

        // Read the next sample
        float sample = sim_sensor_read_sample();

        // Check if the sample is valid
        if (isnan(sample)) {
            continue;
        }

        // Store the sample in the ring buffer
        int ret = ring_buffer_add(ring_buffer, &sample, sizeof(sample));
        if (ret != 0) {
            LOG_ERR("Failed to store sample in the ring buffer (err: %d - %s)", ret, strerror(-ret));
            continue;
        }

        LOG_DBG("Stored: %.1f", sample);
    }
}

void sensor_thread_start(ring_buffer_t* ring_buffer) {
    k_thread_create(&sensor_thread, sensor_thread_stack, SENSOR_THREAD_STACK_SIZE, (k_thread_entry_t) sensor_thread_loop, ring_buffer, NULL, NULL,
        SENSOR_THREAD_PRIO, 0, K_NO_WAIT);
}
```
